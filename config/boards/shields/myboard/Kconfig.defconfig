## config/west.yml
```yaml
manifest:
  remotes:
    - name: zmkfirmware
      url-base: https://github.com/zmkfirmware
  projects:
    - name: zmk
      remote: zmkfirmware
      revision: main  # <--- CHANGE THIS TO 'main'
      import: app/west.yml
  self:
    path: config
```
